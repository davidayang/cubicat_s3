## Kconfig.projbuild
```kconfig
menu "Cubicat Configuration"
	config DOUBLE_BUFFERING
		bool "Enable Display Double Buffering"
		default y
		help
			Enable display double buffering for higher preformance.

    config REMOVE_GRAPHIC_ENGINE
        bool "Remove Graphic Engine"
        default n
        help
            Remove embedded graphic engine.

    config ENABLE_BILINEAR_FILTER
        bool "Enable Bilinear Filter"
        default y
        help
            Render texture use bilinear interpolation if necessary. Get better result but affects drawing efficiency significantly

    config JAVASCRIPT_ENABLE
        bool "Enable JavaScript"
        default y
        help
            Enable JavaScript
    
    choice Board_Type
        prompt "Board Type"
        default CUBICAT_S3
        help
            Select the board you use.

    config CUBICAT_S3
        bool "Cubicat s3 device"
        default y
        help
            Cubicat s3 device.

    config BREAD_BOARD
        bool "Bread board"
        default n
        help
            Custom bread board.
    endchoice

        
    menu "LCD Configuration"
        depends on BREAD_BOARD
        config ENABLE_LCD
            bool "Enable lcd"
            default y
            help
                Enable lcd support, for now only support ST7789

        config LCD_WIDTH
            int "lcd width"
            depends on ENABLE_LCD
            default 240
            help
                LCD width

        config LCD_HEIGHT
            int "lcd height"
            depends on ENABLE_LCD
            default 240
            help
                LCD height
        
        config LCD_SCL
            int "lcd clock gpio"
            depends on ENABLE_LCD
            default 5
            help
                LCD clock gpio number

        config LCD_SDA
            int "lcd data gpio"
            depends on ENABLE_LCD
            default 7
            help
                LCD data gpio number

        config LCD_RST
            int "lcd reset gpio"
            depends on ENABLE_LCD
            default 6
            help
                LCD reset gpio number

        config LCD_DC
            int "lcd dc gpio"
            depends on ENABLE_LCD
            default 4
            help
                LCD dc gpio number
        
        config ENABLE_TOUCH
            bool "Enable touch"
            depends on ENABLE_LCD
            default n
            help
                Enable touch screen only support GT911 for now

        config TOUCH_SDA_GPIO
            int "touch sda gpio"
            depends on ENABLE_TOUCH
            default 21
            help
                touch sda gpio number

        config TOUCH_SCL_GPIO
            int "touch scl gpio"
            depends on ENABLE_TOUCH
            default 47
            help
                touch scl gpio number

        config TOUCH_RST_GPIO
            int "touch reset gpio"
            depends on ENABLE_TOUCH
            default 17
            help
                touch reset gpio number

        config TOUCH_INT_GPIO
            int "touch interrupt gpio"
            depends on ENABLE_TOUCH
            default 18
            help
                touch interrupt gpio number
    endmenu

    menu "Audio Configuration"
        depends on BREAD_BOARD
        config USE_AUDIO_CODEC
            bool "Use audio codec"
            default y
            help
                Combine speaker and microphone with audio codec

        config PDM_MICPHONE
            bool "PDM micphone"
            default n
            help
                Use pdm micphone

        config SPEAKER_WS_GPIO
            int "speaker ws gpio"
            depends on !USE_AUDIO_CODEC
            default 13
            help
                speaker ws gpio number

        config SPEAKER_BCK_GPIO
            int "speaker bck gpio"
            depends on !USE_AUDIO_CODEC
            default 12
            help
                speaker bck gpio number

        config SPEAKER_DATA_GPIO
            int "speaker data gpio"
            default 11
            help
                speaker data gpio number

        config SPEAKER_EN_GPIO
            int "speaker enable gpio"
            default 10
            help
                speaker enable gpio number
                
        config SPEAKER_SAMPLE_RATE
            int "speaker sample rate"
            depends on !USE_AUDIO_CODEC
            default 16000
            help
                speaker sample rate

        config SPEAKER_BIT_WIDTH
            int "speaker bit width"
            depends on !USE_AUDIO_CODEC
            default 16
            help
                speaker bit width

        config MIC_BCK_GPIO
            int "microphone clock gpio"
            depends on !USE_AUDIO_CODEC
            default 8
            help
                microphone clock gpio number

        config MIC_WS_GPIO
            int "microphone ws gpio"
            depends on !USE_AUDIO_CODEC
            default 13
            help
                microphone ws gpio number, use -1 for pdm mode

        config MIC_DATA_GPIO
            int "microphone data gpio"
            default 14
            help
                microphone data gpio number
        
        config MIC_SAMPLE_RATE
            int "microphone sample rate"
            depends on !USE_AUDIO_CODEC
            default 16000
            help
                microphone sample rate

        config MIC_BIT_WIDTH
            int "microphone bit width"
            depends on !USE_AUDIO_CODEC
            default 16
            help
                microphone bit width

        config AUDIO_CODEC_BCLK_GPIO
            int "audio codec bclk/sck gpio"
            depends on USE_AUDIO_CODEC
            default 12
            help
                audio codec bit clock gpio number

        config AUDIO_CODEC_WS_GPIO
            int "audio codec ws/lrck gpio"
            depends on USE_AUDIO_CODEC
            default 13
            help
                audio codec words select gpio number

        config AUDIO_CODEC_SAMPLE_RATE
            int "audio codec data sample rate"
            depends on USE_AUDIO_CODEC
            default 16000
            help
                audio codec data sample rate

        config AUDIO_CODEC_BIT_WIDTH
            int "audio codec data bit width"
            depends on USE_AUDIO_CODEC
            default 16
            help
                audio codec data bit width
    endmenu
endmenu
```
